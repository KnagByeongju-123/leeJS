/*
 * 개인용 온습도계  v2.2  (기존 공장 화면과 동일: 한글 온도/습도/체감 + WiFi 상태점)
 *  - 보드: TTGO T-Display (ESP32) + SHT41 (I2C SDA=21 SCL=22, 0x44)
 *  - 화면: 세로, 한글 라벨(이미지) + 7세그 숫자 + 우상단 상태점
 *          (회색=WiFi끊김 / 초록=전송OK / 빨강=전송실패)
 *  - 전송: Google Sheet에 1시간마다 기록 (Apps Script 웹앱, Supabase 미사용)
 *
 *  배선: SHT41  VIN->3.3V(5V 금지) / GND / SDA->GPIO21 / SCL->GPIO22
 *  IDE : ESP32 core 2.0.17, 보드 "ESP32 Dev Module", 업로드 속도 115200
 *
 *  ▼▼ 아래 WiFi 2곳만 본인 환경으로 수정 ▼▼
 */
#define WIFI_SSID  "여기에_WiFi이름"
#define WIFI_PASS  "여기에_WiFi비번"
//  ▲▲ 여기까지 ▲▲

#include <Wire.h>
#include "Adafruit_SHT4x.h"
#include <TFT_eSPI.h>
#include <WiFi.h>
#include <WiFiMulti.h>
#include <WiFiClientSecure.h>
#include <HTTPClient.h>
#include <time.h>
#include <math.h>

#define SHT_SDA 21
#define SHT_SCL 22

const char* GS_URL      = "여기에_웹앱_URL_붙여넣기";  // 모든 보드 동일 (시트 1개 공유)
const char* DEVICE_NAME = "온습도계1";                // ★ 보드마다 다르게 (예: 안방, 거실, 창고)

const unsigned long SEND_INTERVAL = 3600000; // 1시간 전송
const unsigned long DISP_INTERVAL = 2000;    // 2초 화면 갱신
const char* HEAD_LABEL = "MY ENV";           // 좌상단 표시(영문 - 폰트상 한글 미지원)
#define LBL_TEMP_W 46
#define LBL_TEMP_H 24
const uint16_t LBL_TEMP[] PROGMEM = { 0x0000, 0x0000, 0x0000, 0x0000, 0x0000, 0x0000, 0x0000, 0x0000, 0x0000, 0x0000, 0x0000, 0x0000, 0x0000,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 0x0000, 0x0000 };

#define LBL_HUMI_W 46
#define LBL_HUMI_H 26
const uint16_t LBL_HUMI[] PROGMEM = { 0x0000, 0x0000, 0x0000, 0x0000, 0x0000, 0x0000, 0x0000, 0x0000, 0x0000, 0x0000, 0x0000, 0x0000, 0x0000,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 0x0000, 0x0000 };

#define LBL_FEEL_W 46
#define LBL_FEEL_H 26
const uint16_t LBL_FEEL[] PROGMEM = { 0x0000, 0x0000, 0x0000, 0x0000, 0x0000, 0x0000, 0x0000, 0x0000, 0x0000, 0x0000, 0x0000, 0x0000, 0x0000,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 0x0000, 0x0000 };


TFT_eSPI tft = TFT_eSPI();
Adafruit_SHT4x sht4 = Adafruit_SHT4x();
WiFiMulti wifiMulti;

volatile float gTemp = 0, gHumi = 0, gFeel = 0;
volatile bool lastSendOK = false;
bool sensorOK = false;

// 체감온도 (NWS 열지수, 섭씨) — 공장 펌웨어와 동일
float heatIndexC(float Tc, float R) {
  float T = Tc * 1.8 + 32.0;
  float HI;
  if (T < 80.0) {
    HI = 0.5 * (T + 61.0 + (T - 68.0) * 1.2 + R * 0.094);
  } else {
    HI = -42.379 + 2.04901523 * T + 10.14333127 * R
         - 0.22475541 * T * R - 0.00683783 * T * T - 0.05481717 * R * R
         + 0.00122874 * T * T * R + 0.00085282 * T * R * R - 0.00000199 * T * T * R * R;
    if (R < 13 && T >= 80 && T <= 112)
      HI -= ((13.0 - R) / 4.0) * sqrt((17.0 - fabs(T - 95.0)) / 17.0);
    else if (R > 85 && T >= 80 && T <= 87)
      HI += ((R - 85.0) / 10.0) * ((87.0 - T) / 5.0);
  }
  return (HI - 32.0) / 1.8;
}

// 화면 고정 요소 (한글 라벨 3행)
void drawFrame() {
  tft.fillScreen(TFT_BLACK);
  int cx = tft.width() / 2;
  tft.pushImage(cx - LBL_TEMP_W / 2, 14,  LBL_TEMP_W, LBL_TEMP_H, LBL_TEMP);
  tft.pushImage(cx - LBL_HUMI_W / 2, 89,  LBL_HUMI_W, LBL_HUMI_H, LBL_HUMI);
  tft.pushImage(cx - LBL_FEEL_W / 2, 164, LBL_FEEL_W, LBL_FEEL_H, LBL_FEEL);
  tft.setTextDatum(TL_DATUM);
  tft.setTextColor(TFT_YELLOW, TFT_BLACK);
  tft.drawString(HEAD_LABEL, 3, 2, 1);
}

// 측정값 / 상태등 갱신
void drawValues() {
  int cx = tft.width() / 2;
  char buf[16];
  tft.setTextDatum(TC_DATUM);
  tft.setTextPadding(tft.width());
  snprintf(buf, sizeof(buf), "%.1f", gTemp);
  tft.setTextColor(TFT_YELLOW, TFT_BLACK); tft.drawString(buf, cx, 40, 7);   // 온도 노랑
  snprintf(buf, sizeof(buf), "%.1f", gHumi);
  tft.setTextColor(TFT_CYAN, TFT_BLACK);   tft.drawString(buf, cx, 115, 7);  // 습도 하늘색
  snprintf(buf, sizeof(buf), "%.1f", gFeel);
  tft.setTextColor(TFT_WHITE, TFT_BLACK);  tft.drawString(buf, cx, 190, 7);  // 체감 흰색

  uint16_t c = (WiFi.status() != WL_CONNECTED) ? TFT_DARKGREY
                                               : (lastSendOK ? TFT_GREEN : TFT_RED);
  tft.fillCircle(tft.width() - 7, 6, 4, c);
}

String kstTimestamp() {
  struct tm ti; if (!getLocalTime(&ti, 500)) return "";
  char ts[32]; strftime(ts, sizeof(ts), "%Y-%m-%dT%H:%M:%S+09:00", &ti);
  return String(ts);
}

void readSensor() {
  if (!sensorOK) return;
  sensors_event_t hum, temp;
  if (sht4.getEvent(&hum, &temp)) {
    gTemp = temp.temperature;
    gHumi = hum.relative_humidity;
    gFeel = heatIndexC(gTemp, gHumi);
  }
}

bool sendData() {
  if (WiFi.status() != WL_CONNECTED) return false;
  String body = "{";
  body += "\"name\":\"" + String(DEVICE_NAME) + "\",";
  body += "\"temperature\":" + String(gTemp, 2) + ",";
  body += "\"humidity\":"    + String(gHumi, 2) + ",";
  body += "\"feels_like\":"  + String(gFeel, 2);
  body += "}";

  WiFiClientSecure client; client.setInsecure();
  HTTPClient https; https.setConnectTimeout(8000);
  // Apps Script 는 302 리다이렉트 → POST 그대로 따라가도록 강제
  https.setFollowRedirects(HTTPC_FORCE_FOLLOW_REDIRECTS);
  if (!https.begin(client, GS_URL)) return false;
  https.addHeader("Content-Type", "application/json");
  int code = https.POST(body); https.end();
  Serial.printf("[sheets] POST -> %d\n", code);
  return (code == 200 || code == 302);
}

void setup() {
  Serial.begin(115200);
  delay(200);

  tft.init();
  tft.setRotation(0);          // 세로
  drawFrame();

  Wire.begin(SHT_SDA, SHT_SCL);
  sensorOK = sht4.begin(&Wire);
  if (sensorOK) {
    sht4.setPrecision(SHT4X_HIGH_PRECISION);
    sht4.setHeater(SHT4X_NO_HEATER);
  } else {
    Serial.println("[SHT41] 센서 인식 실패 - 배선/주소(0x44) 확인");
  }

  WiFi.mode(WIFI_STA);
  wifiMulti.addAP(WIFI_SSID, WIFI_PASS);
  configTime(9 * 3600, 0, "pool.ntp.org", "time.google.com");

  readSensor();                // 부팅 즉시 1회 측정/표시
  drawValues();
}

void loop() {
  static unsigned long lastDisp = 0, lastSend = 0, lastTry = 0;

  if (WiFi.status() != WL_CONNECTED && millis() - lastTry > 5000) {
    lastTry = millis();
    wifiMulti.run(8000);
  }
  if (millis() - lastDisp >= DISP_INTERVAL) {
    lastDisp = millis();
    readSensor();
    drawValues();
  }
  if (WiFi.status() == WL_CONNECTED && (millis() - lastSend >= SEND_INTERVAL || lastSend == 0)) {
    lastSend = millis();
    lastSendOK = sendData();
  }
  delay(20);
}
